#include <SPI.h>
#include <SimpleDHT.h>
#include "epd2in9b_V4.h"

// 腳位設定
const int DHT_PIN = 14;
const int LIGHT_PIN = 33;
const unsigned long UPDATE_INTERVAL = 60000UL;

constexpr int BYTES_PER_ROW = EPD_WIDTH / 8;
constexpr int IMAGE_BYTES = EPD_WIDTH * EPD_HEIGHT / 8;
uint8_t blackImage[IMAGE_BYTES];
uint8_t redImage[IMAGE_BYTES];

Epd epd;
SimpleDHT11 dht11(DHT_PIN);

enum PixelColor { WHITE_PIXEL, BLACK_PIXEL, RED_PIXEL };

// -------------------------------------------------------------
// 精細點陣圖資 (Bitmap Data)
// -------------------------------------------------------------

// 16x24 溫度計外框點陣
const uint8_t PROGMEM icon_temp_black[] = {
  0x03, 0xC0, 0x04, 0x20, 0x08, 0x10, 0x08, 0x10, 0x08, 0x10, 0x08, 0x10,
  0x08, 0x10, 0x08, 0x10, 0x08, 0x10, 0x08, 0x10, 0x08, 0x10, 0x08, 0x10,
  0x08, 0x10, 0x08, 0x10, 0x10, 0x08, 0x20, 0x04, 0x20, 0x04, 0x40, 0x02,
  0x40, 0x02, 0x20, 0x04, 0x10, 0x08, 0x0F, 0xF0, 0x00, 0x00, 0x00, 0x00
};

// 16x24 溫度計液面紅點陣
const uint8_t PROGMEM icon_temp_red[] = {
  0x00, 0x00, 0x00, 0x00, 0x00, 0x00, 0x00, 0x00, 0x01, 0x80, 0x01, 0x80,
  0x01, 0x80, 0x01, 0x80, 0x01, 0x80, 0x01, 0x80, 0x01, 0x80, 0x01, 0x80,
  0x01, 0x80, 0x01, 0x80, 0x03, 0xC0, 0x07, 0xE0, 0x0F, 0xF0, 0x0F, 0xF0,
  0x0F, 0xF0, 0x07, 0xE0, 0x03, 0xC0, 0x00, 0x00, 0x00, 0x00, 0x00, 0x00
};

// 24x24 水滴外框點陣
const uint8_t PROGMEM icon_humi_black[] = {
  0x00, 0x10, 0x00, 0x00, 0x38, 0x00, 0x00, 0x38, 0x00, 0x00, 0x7C, 0x00,
  0x00, 0xEE, 0x00, 0x01, 0xC7, 0x00, 0x01, 0x83, 0x80, 0x03, 0x81, 0xC0,
  0x07, 0x00, 0xE0, 0x0E, 0x00, 0x70, 0x1C, 0x00, 0x38, 0x1C, 0x00, 0x38,
  0x38, 0x00, 0x1C, 0x38, 0x00, 0x1C, 0x38, 0x00, 0x1C, 0x38, 0x00, 0x1C,
  0x1C, 0x00, 0x38, 0x1C, 0x00, 0x38, 0x0E, 0x00, 0x70, 0x07, 0x00, 0xE0,
  0x03, 0x81, 0xC0, 0x00, 0xFF, 0x00, 0x00, 0x00, 0x00, 0x00, 0x00, 0x00
};

// 24x24 水滴液面紅點陣
const uint8_t PROGMEM icon_humi_red[] = {
  0x00, 0x00, 0x00, 0x00, 0x00, 0x00, 0x00, 0x00, 0x00, 0x00, 0x00, 0x00,
  0x00, 0x00, 0x00, 0x00, 0x00, 0x00, 0x00, 0x00, 0x00, 0x00, 0x00, 0x00,
  0x00, 0x00, 0x00, 0x00, 0x00, 0x00, 0x00, 0x00, 0x00, 0x00, 0x00, 0x00,
  0x00, 0x00, 0x00, 0x00, 0x00, 0x00, 0x00, 0xFF, 0x00, 0x03, 0xFF, 0xC0,
  0x03, 0xFF, 0xC0, 0x03, 0xFF, 0xC0, 0x01, 0xFF, 0x80, 0x00, 0xFF, 0x00,
  0x00, 0x3C, 0x00, 0x00, 0x00, 0x00, 0x00, 0x00, 0x00, 0x00, 0x00, 0x00
};

// 24x24 光照圖示黑點陣
const uint8_t PROGMEM icon_light_black[] = {
  0x00, 0x10, 0x00, 0x00, 0x10, 0x00, 0x04, 0x10, 0x20, 0x02, 0x00, 0x40,
  0x01, 0x38, 0x80, 0x00, 0x44, 0x00, 0x00, 0x82, 0x00, 0x01, 0x01, 0x00,
  0x39, 0x00, 0x9C, 0x01, 0x00, 0x80, 0x01, 0x00, 0x80, 0x01, 0x00, 0x80,
  0x39, 0x00, 0x9C, 0x01, 0x00, 0x80, 0x00, 0x82, 0x00, 0x00, 0x44, 0x00,
  0x01, 0x38, 0x80, 0x02, 0x00, 0x40, 0x04, 0x10, 0x20, 0x00, 0x10, 0x00,
  0x00, 0x10, 0x00, 0x00, 0x00, 0x00, 0x00, 0x00, 0x00, 0x00, 0x00, 0x00
};

// 24x24 光照圖示紅點陣
const uint8_t PROGMEM icon_light_red[] = {
  0x00, 0x00, 0x00, 0x00, 0x00, 0x00, 0x00, 0x00, 0x00, 0x00, 0x00, 0x00,
  0x00, 0x00, 0x00, 0x00, 0x00, 0x00, 0x00, 0x00, 0x00, 0x00, 0x00, 0x00,
  0x00, 0x00, 0x00, 0x00, 0x38, 0x00, 0x00, 0x38, 0x00, 0x00, 0x38, 0x00,
  0x00, 0x00, 0x00, 0x00, 0x00, 0x00, 0x00, 0x00, 0x00, 0x00, 0x00, 0x00,
  0x00, 0x00, 0x00, 0x00, 0x00, 0x00, 0x00, 0x00, 0x00, 0x00, 0x00, 0x00,
  0x00, 0x00, 0x00, 0x00, 0x00, 0x00, 0x00, 0x00, 0x00, 0x00, 0x00, 0x00
};

// 5x7 基礎字型庫
const uint8_t FONT_5X7[][5] PROGMEM = {
  {0x3E,0x51,0x49,0x45,0x3E}, {0x00,0x42,0x7F,0x40,0x00}, {0x42,0x61,0x51,0x49,0x46},
  {0x21,0x41,0x45,0x4B,0x31}, {0x18,0x14,0x12,0x7F,0x10}, {0x27,0x45,0x45,0x45,0x39},
  {0x3C,0x4A,0x49,0x49,0x30}, {0x01,0x71,0x09,0x05,0x03}, {0x36,0x49,0x49,0x49,0x36},
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  {0x63,0x14,0x08,0x14,0x63}, {0x07,0x08,0x70,0x08,0x07}, {0x61,0x51,0x49,0x45,0x43}
};

// -------------------------------------------------------------
// 繪圖核心函式
// -------------------------------------------------------------

void setPixel(int x, int y, PixelColor color) {
  if (x < 0 || x >= EPD_WIDTH || y < 0 || y >= EPD_HEIGHT) return;
  int index = y * BYTES_PER_ROW + (x / 8);
  uint8_t mask = 0x80 >> (x % 8);
  if (color == BLACK_PIXEL) {
    blackImage[index] &= (uint8_t)~mask;
    redImage[index] |= mask;
  } else if (color == RED_PIXEL) {
    blackImage[index] |= mask;
    redImage[index] &= (uint8_t)~mask;
  } else {
    blackImage[index] |= mask;
    redImage[index] |= mask;
  }
}

void fillRect(int x, int y, int w, int h, PixelColor color) {
  for (int yy = y; yy < y + h; ++yy)
    for (int xx = x; xx < x + w; ++xx) setPixel(xx, yy, color);
}

void drawRect(int x, int y, int w, int h, PixelColor color) {
  for (int xx = x; xx < x + w; ++xx) { setPixel(xx, y, color); setPixel(xx, y + h - 1, color); }
  for (int yy = y; yy < y + h; ++yy) { setPixel(x, yy, color); setPixel(x + w - 1, yy, color); }
}

// 繪製點陣陣列 (Bitmap)
void drawBitmap(int x, int y, const uint8_t *bitmap, int w, int h, PixelColor color) {
  int byteWidth = (w + 7) / 8;
  for (int j = 0; j < h; j++) {
    for (int i = 0; i < w; i++) {
      if (pgm_read_byte(bitmap + j * byteWidth + i / 8) & (128 >> (i & 7))) {
        setPixel(x + i, y + j, color);
      }
    }
  }
}

int glyphIndex(char c) {
  if (c >= '0' && c <= '9') return c - '0';
  const char* letters = "ABCDEFGHIJKLMNOPQRSTUVWXYZ";
  const char* p = strchr(letters, c);
  return p ? 10 + (int)(p - letters) : -1;
}

void drawChar(int x, int y, char c, int scale, PixelColor color) {
  if (c == '%') {
    fillRect(x, y, scale, scale, color); 
    fillRect(x + 4 * scale, y + 6 * scale, scale, scale, color);
    for (int i = 0; i < 7; ++i) fillRect(x + (i % 2 ? 3 : 2) * scale, y + (i + 1) * scale, scale, scale, color);
    return;
  }
  if (c == '_') { fillRect(x, y + 6 * scale, 5 * scale, scale, color); return; }
  int gi = glyphIndex(c); if (gi < 0) return;
  for (int col = 0; col < 5; ++col) {
    uint8_t bits = pgm_read_byte(&FONT_5X7[gi][col]);
    for (int row = 0; row < 7; ++row) if (bits & (1 << row)) fillRect(x + col * scale, y + row * scale, scale, scale, color);
  }
}

void drawText(int x, int y, const char* text, int scale, PixelColor color) {
  while (*text) { drawChar(x, y, *text++, scale, color); x += 6 * scale; }
}

// -------------------------------------------------------------
// 卡片與UI繪製
// -------------------------------------------------------------

void drawCard(int y, const char* label, const char* value, const char* unit, int iconType) {
  // 1. 卡片外框與左側紅色裝飾條
  drawRect(6, y, 116, 68, BLACK_PIXEL);
  fillRect(6, y, 7, 68, RED_PIXEL);
  
  // 2. 渲染對應的點陣圖示
  if (iconType == 1) { // 溫度
    drawBitmap(18, y + 22, icon_temp_black, 16, 24, BLACK_PIXEL);
    drawBitmap(18, y + 22, icon_temp_red, 16, 24, RED_PIXEL);
  } else if (iconType == 2) { // 濕度
    drawBitmap(16, y + 22, icon_humi_black, 24, 24, BLACK_PIXEL);
    drawBitmap(16, y + 22, icon_humi_red, 24, 24, RED_PIXEL);
  } else if (iconType == 3) { // 光照
    drawBitmap(16, y + 22, icon_light_black, 24, 24, BLACK_PIXEL);
    drawBitmap(16, y + 22, icon_light_red, 24, 24, RED_PIXEL);
  }

  // 3. 標題與數據
  drawText(48, y + 10, label, 2, BLACK_PIXEL);
  drawText(48, y + 34, value, strlen(value) > 2 ? 2 : 3, BLACK_PIXEL);
  
  // 4. 單位（置右下方）
  drawText(102, y + 46, unit, 1, RED_PIXEL);
}

void drawScreen(bool tempValid, byte temp, bool humValid, byte hum, int light) {
  memset(blackImage, 0xFF, sizeof(blackImage));
  memset(redImage, 0xFF, sizeof(redImage));
  
  // 背景與頂部區域
  fillRect(0, 0, 128, 296, WHITE_PIXEL);
  fillRect(0, 0, 128, 28, RED_PIXEL);
  drawText(16, 6, "ENV DATA", 2, WHITE_PIXEL);

  // 三張卡片
  drawCard(36, "TEMP", tempValid ? (String(temp).c_str()) : "_", "C", 1);
  drawCard(110, "HUMI", humValid ? (String(hum).c_str()) : "_", "%", 2);
  String lightText = String(light);
  drawCard(184, "LIGHT", lightText.c_str(), "%", 3);

  // 底部更新時間提示
  drawText(12, 260, "LAST UPDATED", 1, BLACK_PIXEL);
  drawText(12, 273, "60 SECONDS AGO", 1, BLACK_PIXEL);

  epd.Display(blackImage, redImage);
}

void readAndDisplay() {
  byte temp = 0, hum = 0;
  bool dhtOK = (dht11.read(&temp, &hum, NULL) == SimpleDHTErrSuccess);
  int rawLight = analogRead(LIGHT_PIN);
  int light = constrain(map(rawLight, 0, 4095, 0, 100), 0, 100);
  
  Serial.printf("TEMP=%s HUMI=%s LIGHT=%d\n", dhtOK ? String(temp).c_str() : "_", dhtOK ? String(hum).c_str() : "_", light);
  drawScreen(dhtOK, temp, dhtOK, hum, light);
}

void setup() {
  Serial.begin(115200);
  pinMode(LIGHT_PIN, INPUT);
  delay(200);
  
  if (epd.Init() != 0) { 
    Serial.println("e-Paper init failed"); 
    return; 
  }
  epd.Clear();
  readAndDisplay();
}

void loop() {
  static unsigned long lastUpdate = 0;
  if (millis() - lastUpdate >= UPDATE_INTERVAL) { 
    lastUpdate = millis(); 
    readAndDisplay(); 
  }
  delay(50);
}